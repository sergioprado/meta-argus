## conf/distro/argus.conf
```bitbake
DISTRO_NAME = "Argus Operating System"
DISTRO_VERSION = "0.1.0"

TARGET_VENDOR = "-argus"

MAINTAINER = "Sergio Prado <sergio.prado@e-labworks.com>"

TCMODE = "default"
TCLIBC = "glibc"

PACKAGE_CLASSES ?= "package_ipk"

SDK_VENDOR = "-argussdk"
SDK_VERSION = "${@d.getVar('DISTRO_VERSION').replace('snapshot-${METADATA_REVISION}', 'snapshot')}"
SDK_VERSION[vardepvalue] = "${SDK_VERSION}"
SDK_NAME = "${DISTRO}-${TCLIBC}-${SDKMACHINE}-${IMAGE_BASENAME}-${TUNE_PKGARCH}-${MACHINE}"
SDKPATHINSTALL = "/opt/${DISTRO}/${SDK_VERSION}"

ARGUS_BUILD_TYPE ?= "prod"
DISTROOVERRIDES:append = ":${@bb.utils.contains("ARGUS_BUILD_TYPE", "prod", "argus-prod", "argus-dev", d)}"

DISTRO_FEATURES += "\
    acl \
    ipsec \
    security \
"

# required when using sysvinit and building a read-only rootfs
SERIAL_CONSOLES_CHECK:forcevariable = ""

INITRAMFS_IMAGE = "argus-image-ramdisk"
INITRAMFS_IMAGE_BUNDLE = "0"

KERNEL_CLASSES = "kernel-fitimage"
KERNEL_IMAGETYPES = "fitImage"

# rootfs image that will be used to create dmverity image
# override it when building a different image
DM_VERITY_IMAGE ?= "argus-image"
DM_VERITY_IMAGE_TYPE ?= "ext4"

# enable creation of dmverity image
IMAGE_CLASSES += "dm-verity-img"
WICVARS:append = "\
    DM_VERITY_IMAGE \
    DM_VERITY_IMAGE_TYPE \
"

# mount the rootfs image only from a dmverity image
BAD_RECOMMENDATIONS += "initramfs-module-rootfs"

# preferred (r)providers
PREFERRED_RPROVIDER_libdevmapper-native = "lvm2-native"

require conf/distro/include/security_flags.inc

# extend machine configuration if needed
include conf/machine/argus-${MACHINE}.conf
```

## conf/layer.conf
```bitbake
BBPATH .= ":${LAYERDIR}"

BBFILES += "${LAYERDIR}/recipes-*/*/*.bb \
            ${LAYERDIR}/recipes-*/*/*.bbappend"

BBFILE_COLLECTIONS += "meta-argus"
BBFILE_PATTERN_meta-argus = "^${LAYERDIR}/"
BBFILE_PRIORITY_meta-argus = "10"

LAYERDEPENDS_meta-argus = "core security"
LAYERSERIES_COMPAT_meta-argus = "kirkstone"
```
